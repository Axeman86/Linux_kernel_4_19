## drivers/globalfifo/Kconfig
```kconfig
#
# globalmem configure
#

menu "Global FiFo Device Driver Configuration"
comment "Glocal FiFo Char Device Driver"

config GLOBALFIFO
    tristate "Global FiFo Char Device Driver"
    default n
    help
      This is a simple global fifo device driver.

endmenu
```

## drivers/globalmem/Kconfig
```kconfig
#
# globalmem configure
#

menu "Global Memory Device Driver Configuration"
comment "Glocal Memeory Char Device Driver"

config GLOBALMEM
    tristate "Global Memory Char Device Driver"
    default n
    help
      This is a simple global memory device driver.

endmenu
```

## drivers/second/Kconfig
```kconfig
#
# globalmem configure
#

menu "Second Device Driver Configuration"
comment "Second Char Device Driver"

config SECOND
    tristate "Second Char Device Driver"
    default n
    help
      This is a simple global second device driver.

endmenu
```
